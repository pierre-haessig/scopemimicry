## CMakeLists.txt
```
#-------------------------------------------------------------------------------
# Zephyr Example Application
#
# Copyright (c) 2021 Nordic Semiconductor ASA
# SPDX-License-Identifier: Apache-2.0

# set(BOARD qemu_x86_64)
# set(CMAKE_COMPILE_WARNING_AS_ERROR OFF)
set(CMAKE_EXPORT_COMPILE_COMMANDS ON)
cmake_minimum_required(VERSION 3.20)
# find_package(Zephyr COMPONENTS unittest REQUIRED HINTS $ENV{ZEPHYR_BASE})
find_package(Zephyr REQUIRED HINTS $ENV{ZEPHYR_BASE})
project(test_scope)
target_include_directories(app PRIVATE src)
# library sources / headers
file (GLOB app_sources
    src/*.cpp
    ../src/ScopeMimicry.cpp
    )

# message(STATUS "######### ${app_sources} ############")
target_include_directories(app PRIVATE ../src)
target_sources(app PRIVATE 
    ${app_sources}
    )
```

## prj.conf
```kconfig
# Copyright (c) 2021 Nordic Semiconductor ASA
# SPDX-License-Identifier: Apache-2.0
#
# This file contains selected Kconfig options for the application.

CONFIG_CPP=y
CONFIG_STD_CPP2A=y

CONFIG_NEWLIB_LIBC=y
CONFIG_NEWLIB_LIBC_FLOAT_PRINTF=y

CONFIG_CMSIS_DSP=y
CONFIG_CMSIS_DSP_FASTMATH=y
CONFIG_CMSIS_DSP_CONTROLLER=y
CONFIG_FPU=y

CONFIG_HWINFO=y

CONFIG_LOG=y
CONFIG_LOG_MODE_MINIMAL=y
CONFIG_ASSERT=y

CONFIG_CONSOLE_SUBSYS=y
CONFIG_CONSOLE_GETCHAR=y
# CONFIG_CONSOLE_PUTCHAR=y
CONFIG_STDOUT_CONSOLE=y


CONFIG_HEAP_MEM_POOL_SIZE=2048
```

## src/main.cpp
```c
#include <zephyr/kernel.h>
#include <zephyr/sys/printk.h>
#include <zephyr/console/console.h>
#include <zephyr/logging/log.h>
#include "ScopeMimicry.h"
#include <arm_math.h>

static float32_t Ilow1;
static float32_t Ilow2;

LOG_MODULE_REGISTER(test_scope);

bool mytrigger(void) {
    return (Ilow1 > 0);
}

int main(void) {
    float32_t f0 = 50.0;
    float32_t t;
    const float32_t Ts = 100e-6;


    ScopeMimicry scope(1024, 2);


    scope.connectChannel(Ilow1, "iLow1");
    scope.connectChannel(Ilow2, "iLow2");
    scope.set_trigger(mytrigger);
    scope.set_delay(0.0);
    for (t=0; t <  2./f0; t+=Ts)  {
        Ilow1 = (t < 1/f0) ? arm_cos_f32(2 * PI * f0 * t): 2*cos(2 * PI * f0 * t); 
        Ilow2 = arm_sin_f32(2 * PI * f0 * t);
        scope.acquire();
    }
    //scope.dump();
    uint8_t *buf = scope.get_buffer();
    uint16_t size = scope.get_buffer_size();
    printk("float size: %i\n", sizeof(float));
    printk("size: %i\n", size);
    printk("length: %i\n", scope.get_length());
    printk("nb chan: %i\n", scope.get_nb_channel());
    // for (int k=0; k < size; k+=4) {
    //     LOG_RAW("%08x\n", *(uint32_t *)(buf+k));
    // }
    LOG_HEXDUMP_INF(buf, size, "essai");
    return 0;
}
```
